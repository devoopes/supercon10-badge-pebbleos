## boards/billboard/Kconfig
```kconfig
# SPDX-FileCopyrightText: 2026 Core Devices LLC
# SPDX-License-Identifier: Apache-2.0

config BOARD_BILLBOARD
    bool
    default y
    select BOARD_PARTITIONS_BILLBOARD
```
